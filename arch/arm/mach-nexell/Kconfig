## arch/arm/mach-nexell/Kconfig
```kconfig
if ARCH_NEXELL

choice
        prompt "Nexell SoCs select"

config ARCH_NXP3220
	bool "NXP3220"
	select CPU_V7
	select DM

config ARCH_NXP3225
	bool "NXP3225"
	select CPU_V7
	select DM

endchoice

config SYS_SOC
	default "nxp3220"
	depends on ARCH_NXP3220 || ARCH_NXP3225

config SYS_VENDOR
        default "nexell"

config QUICKBOOT_QUIET
	bool "NEXELL QUICKBOOT QUIET"
	help
	  Support for nexell quickboot quiet

config REBOOT_MODE
	bool "Support reboot mode"
        default y
	help
	  Support for nexell reboot mode (reboot bootloader, reboot recovery)

config NEXELL_SECURE_IO
	bool
	select ARM_PSCI_FW

source "board/nexell/Kconfig"

endif
```

## board/nexell/Kconfig
```kconfig
if ARCH_NEXELL

choice
	prompt "Board select"

config TARGET_ARTIK310S_TRIKE
	bool "ARTIK310S_TRIKE"
	depends on ARCH_SIP_S31NX
	help
	  Support for artik310s trike board.

config TARGET_NXP3220_VTK
	bool "NXP3220_VTK"
	depends on ARCH_NXP3220
	help
	  Support for nxp3220 validation test board.

config TARGET_NXP3220_EVB
	bool "NXP3220_EVB"
	depends on ARCH_NXP3220
	help
	  Support for nxp3220 evb board.

endchoice

config SYS_CONFIG_NAME
        string "Board header file"
        help
          This option should contain the base name of board header file.
          The header file include/configs/<CONFIG_SYS_CONFIG_NAME>.h
          should be included from include/config.h.

source "board/nexell/artik310s_trike/Kconfig"
source "board/nexell/nxp3220_vtk/Kconfig"
source "board/nexell/nxp3220_evb/Kconfig"
source "board/nexell/common/Kconfig"

endif
```

## board/nexell/nxp3220_evb/Kconfig
```kconfig
if TARGET_NXP3220_EVB || TARGET_NXP3220_DAUDIO || \
   TARGET_NXP3220_EVB2 || TARGET_NXP3220_DAUDIO2

config SYS_BOARD
	default "nxp3220_evb"

config CHECK_REVISION
	bool "Check board revision"

endif
```

## configs/artik310s_trike_defconfig
```kconfig
CONFIG_ARM=y
CONFIG_SYS_CONFIG_NAME="artik310s_trike"
CONFIG_ARM_SMCCC=y
CONFIG_ARCH_NEXELL=y
CONFIG_SYS_TEXT_BASE=0x43C00000
CONFIG_ARCH_SIP_S31NX=y
CONFIG_DEFAULT_DEVICE_TREE="sip-s31nx-artik310s-trike"
CONFIG_HUSH_PARSER=y
CONFIG_SYS_PROMPT="artik310s# "
CONFIG_FASTBOOT=y
CONFIG_FASTBOOT_BUF_ADDR=0x40000000
CONFIG_FASTBOOT_BUF_SIZE=0x1C000000
CONFIG_FASTBOOT_FLASH=y
CONFIG_FASTBOOT_FLASH_MMC_DEV=0
CONFIG_CMD_BOOTZ=y
CONFIG_CMD_MD5SUM=y
CONFIG_CMD_MEMINFO=y
CONFIG_CMD_MEMTEST=y
CONFIG_CMD_UNZIP=y
CONFIG_CMD_ADC=y
CONFIG_CMD_DFU=y
CONFIG_CMD_FACTORY_INFO=y
CONFIG_CMD_GPIO=y
CONFIG_CMD_GPT=y
CONFIG_CMD_I2C=y
CONFIG_CMD_MMC=y
CONFIG_CMD_PART=y
CONFIG_CMD_PWM=y
CONFIG_CMD_SPI=y
CONFIG_CMD_USB_MASS_STORAGE=y
CONFIG_CMD_NX_USB_DOWNLOADER=y
CONFIG_CMD_MII=y
CONFIG_CMD_PING=y
CONFIG_CMD_GEN_ETHADDR=y
CONFIG_CMD_TIMER=y
CONFIG_CMD_PMIC=y
CONFIG_CMD_REGULATOR=y
CONFIG_CMD_EXT4=y
CONFIG_CMD_EXT4_WRITE=y
CONFIG_CMD_FAT=y
CONFIG_CMD_FS_GENERIC=y
CONFIG_CMD_FS_UUID=y
CONFIG_PARTITION_TYPE_GUID=y
CONFIG_OF_CONTROL=y
CONFIG_OF_EMBED=y
CONFIG_NET_RANDOM_ETHADDR=y
CONFIG_REGMAP=y
CONFIG_SYSCON=y
CONFIG_ADC_NEXELL=y
CONFIG_CLK=y
CONFIG_CLK_NEXELL=y
CONFIG_DFU_MMC=y
CONFIG_DFU_RAM=y
CONFIG_DM_GPIO=y
CONFIG_NEXELL_GPIO=y
CONFIG_DM_I2C=y
CONFIG_DM_I2C_GPIO=y
CONFIG_SYS_I2C_S3C24X0=y
CONFIG_DM_MMC=y
CONFIG_MMC_DW=y
CONFIG_PHY_REALTEK=y
CONFIG_DM_ETH=y
CONFIG_DWC_ETH_QOS=y
CONFIG_DWC_ETH_QOS_NEXELL=y
CONFIG_PHY_NEXELL_USB2=y
CONFIG_PHY_NXP3220_USB2=y
CONFIG_PINCTRL=y
CONFIG_DM_PMIC=y
CONFIG_DM_PMIC_SM5011=y
CONFIG_DM_REGULATOR_FIXED=y
CONFIG_DM_REGULATOR_GPIO=y
CONFIG_DM_REGULATOR_SM5011=y
CONFIG_DM_PWM=y
CONFIG_PWM_NEXELL=y
CONFIG_DM_SERIAL=y
CONFIG_SYS_NS16550=y
CONFIG_SPI=y
CONFIG_DM_SPI=y
CONFIG_DESIGNWARE_SPI=y
CONFIG_SYSRESET=y
CONFIG_SYSRESET_PSCI=y
CONFIG_TIMER=y
CONFIG_NXP3220_TIMER=y
CONFIG_USB=y
CONFIG_USB_EHCI_HCD=y
CONFIG_USB_EHCI_GENERIC=y
CONFIG_USB_STORAGE=y
CONFIG_USB_GADGET=y
CONFIG_USB_GADGET_MANUFACTURER="Samsung Electronics"
CONFIG_USB_GADGET_VENDOR_NUM=0x18d1
CONFIG_USB_GADGET_PRODUCT_NUM=0x0002
CONFIG_USB_GADGET_DWC2_OTG=y
CONFIG_USB_GADGET_DWC2_NEXELL_OTG=y
CONFIG_USB_GADGET_DWC2_NEXELL_DOWNLOADER=y
CONFIG_OF_LIBFDT_OVERLAY=y
# CONFIG_EFI_LOADER is not set
```

## configs/nxp3220_daudio2_defconfig
```kconfig
CONFIG_ARM=y
CONFIG_SYS_CONFIG_NAME="nxp3220_daudio"
CONFIG_ARM_SMCCC=y
# CONFIG_SPL_USE_ARCH_MEMCPY is not set
# CONFIG_SPL_USE_ARCH_MEMSET is not set
CONFIG_ARCH_NEXELL=y
CONFIG_SYS_TEXT_BASE=0x43C00000
CONFIG_QUICKBOOT_QUIET=y
CONFIG_TARGET_NXP3220_DAUDIO2=y
CONFIG_DEFAULT_DEVICE_TREE="nxp3220-daudio2-rev00"
# CONFIG_ANDROID_BOOT_IMAGE is not set
CONFIG_BOOTDELAY=0
# CONFIG_CONSOLE_MUX is not set
# CONFIG_DISPLAY_CPUINFO is not set
# CONFIG_DISPLAY_BOARDINFO is not set
CONFIG_HUSH_PARSER=y
CONFIG_SYS_PROMPT="nxp3220# "
CONFIG_FASTBOOT=y
CONFIG_FASTBOOT_BUF_ADDR=0x40010000
CONFIG_FASTBOOT_BUF_SIZE=0x1A000000
CONFIG_USB_FUNCTION_FASTBOOT_PARTMAP=y
CONFIG_FASTBOOT_PARTMAP_PARTITION_GPT=y
CONFIG_FASTBOOT_PARTMAP_FLASH_MMC=y
CONFIG_FASTBOOT_FLASH_MMC_DEV=0
# CONFIG_CMD_BDI is not set
# CONFIG_CMD_CONSOLE is not set
# CONFIG_CMD_BOOTD is not set
# CONFIG_CMD_BOOTM is not set
CONFIG_CMD_BOOTZ=y
# CONFIG_CMD_BOOTEFI is not set
CONFIG_CMD_BOOTL=y
# CONFIG_CMD_ELF is not set
# CONFIG_CMD_IMI is not set
# CONFIG_CMD_XIMG is not set
# CONFIG_CMD_FLASH is not set
# CONFIG_CMD_LOADB is not set
# CONFIG_CMD_LOADS is not set
CONFIG_CMD_MMC=y
CONFIG_CMD_PART=y
CONFIG_CMD_NX_USB_DOWNLOADER=y
CONFIG_CMD_BMP=y
CONFIG_CMD_TIMER=y
CONFIG_CMD_EXT4=y
CONFIG_CMD_EXT4_WRITE=y
CONFIG_CMD_FAT=y
CONFIG_CMD_FS_UUID=y
CONFIG_CMD_DOS_MMC=y
CONFIG_OF_CONTROL=y
CONFIG_OF_EMBED=y
CONFIG_ENV_IS_IN_MMC=y
# CONFIG_NET is not set
CONFIG_REGMAP=y
CONFIG_SYSCON=y
CONFIG_CLK=y
CONFIG_CLK_NEXELL=y
CONFIG_DM_GPIO=y
CONFIG_NEXELL_GPIO=y
CONFIG_DM_I2C=y
CONFIG_SYS_I2C_S3C24X0=y
CONFIG_DM_MMC=y
CONFIG_MMC_DW=y
CONFIG_PHY_NEXELL_USB2=y
CONFIG_PHY_NXP3220_USB2=y
CONFIG_PINCTRL=y
CONFIG_DM_PMIC=y
# CONFIG_SPL_PMIC_CHILDREN is not set
CONFIG_DM_PMIC_NXE2000=y
CONFIG_DM_REGULATOR=y
CONFIG_DM_REGULATOR_NXE2000=y
CONFIG_DM_PWM=y
CONFIG_PWM_NEXELL=y
CONFIG_DM_SERIAL=y
CONFIG_SYS_NS16550=y
CONFIG_SYSRESET=y
CONFIG_SYSRESET_PSCI=y
CONFIG_TIMER=y
CONFIG_NXP3220_TIMER=y
CONFIG_USB=y
CONFIG_USB_GADGET=y
CONFIG_USB_GADGET_MANUFACTURER="Nexell"
CONFIG_USB_GADGET_VENDOR_NUM=0x18d1
CONFIG_USB_GADGET_PRODUCT_NUM=0x0002
CONFIG_USB_GADGET_DWC2_OTG=y
CONFIG_USB_GADGET_DWC2_NEXELL_OTG=y
CONFIG_USB_GADGET_DWC2_NEXELL_DOWNLOADER=y
CONFIG_DM_VIDEO=y
CONFIG_SYS_WHITE_ON_BLACK=y
CONFIG_VIDEO_NEXELL=y
CONFIG_VIDEO_NEXELL_RGB=y
CONFIG_REGEX=y
CONFIG_OF_LIBFDT_OVERLAY=y
```

## configs/nxp3220_vtk_defconfig
```kconfig
CONFIG_ARM=y
CONFIG_SYS_CONFIG_NAME="nxp3220_vtk"
CONFIG_ARM_SMCCC=y
CONFIG_ARCH_NEXELL=y
CONFIG_SYS_TEXT_BASE=0x43C00000
CONFIG_DEFAULT_DEVICE_TREE="nxp3220-vtk"
# CONFIG_ANDROID_BOOT_IMAGE is not set
CONFIG_HUSH_PARSER=y
CONFIG_SYS_PROMPT="nxp3220# "
CONFIG_FASTBOOT=y
CONFIG_FASTBOOT_BUF_ADDR=0x40010000
CONFIG_FASTBOOT_BUF_SIZE=0x1A000000
CONFIG_USB_FUNCTION_FASTBOOT_PARTMAP=y
CONFIG_FASTBOOT_PARTMAP_PARTITION_GPT=y
CONFIG_FASTBOOT_PARTMAP_FLASH_MMC=y
CONFIG_FASTBOOT_FLASH_MMC_DEV=0
CONFIG_CMD_BOOTZ=y
CONFIG_CMD_MD5SUM=y
CONFIG_CMD_MEMINFO=y
CONFIG_CMD_MEMTEST=y
CONFIG_CMD_UNZIP=y
CONFIG_CMD_ADC=y
CONFIG_CMD_DFU=y
CONFIG_CMD_GPIO=y
# CONFIG_RANDOM_UUID is not set
CONFIG_CMD_MMC=y
CONFIG_CMD_NAND=y
CONFIG_CMD_NAND_TRIMFFS=y
CONFIG_CMD_PART=y
CONFIG_CMD_SF=y
CONFIG_CMD_USB_MASS_STORAGE=y
CONFIG_CMD_NX_USB_DOWNLOADER=y
CONFIG_CMD_MII=y
CONFIG_CMD_PING=y
CONFIG_CMD_TIMER=y
CONFIG_CMD_PMIC=y
CONFIG_CMD_REGULATOR=y
CONFIG_CMD_EXT4=y
CONFIG_CMD_EXT4_WRITE=y
CONFIG_CMD_FAT=y
CONFIG_CMD_FS_UUID=y
CONFIG_CMD_MTDPARTS=y
CONFIG_CMD_UBI=y
CONFIG_CMD_UBIFS=y
CONFIG_CMD_MBR_MMC=y
CONFIG_OF_CONTROL=y
CONFIG_OF_EMBED=y
CONFIG_ENV_IS_IN_MMC=y
CONFIG_NET_RANDOM_ETHADDR=y
CONFIG_REGMAP=y
CONFIG_SYSCON=y
CONFIG_ADC_NEXELL=y
CONFIG_CLK=y
CONFIG_CLK_NEXELL=y
CONFIG_DFU_MMC=y
CONFIG_DFU_RAM=y
CONFIG_DM_GPIO=y
CONFIG_NEXELL_GPIO=y
CONFIG_DM_I2C=y
CONFIG_SYS_I2C_S3C24X0=y
CONFIG_MISC=y
CONFIG_DM_MMC=y
CONFIG_MMC_DW=y
CONFIG_MTD=y
CONFIG_NAND=y
CONFIG_NAND_NXP3220=y
CONFIG_DM_SPI_FLASH=y
CONFIG_SPI_FLASH=y
CONFIG_SPI_FLASH_BAR=y
CONFIG_SPI_FLASH_STMICRO=y
CONFIG_PHY_REALTEK=y
CONFIG_DM_ETH=y
CONFIG_DWC_ETH_QOS=y
CONFIG_DWC_ETH_QOS_NEXELL=y
CONFIG_PHY_NEXELL_USB2=y
CONFIG_PHY_NXP3220_USB2=y
CONFIG_PINCTRL=y
CONFIG_DM_PMIC=y
CONFIG_DM_PMIC_NXE2000=y
CONFIG_DM_REGULATOR_NXE2000=y
CONFIG_DM_REGULATOR_FIXED=y
CONFIG_DM_REGULATOR_GPIO=y
CONFIG_DM_SERIAL=y
CONFIG_SYS_NS16550=y
CONFIG_SPI=y
CONFIG_DM_SPI=y
CONFIG_DESIGNWARE_SPI=y
CONFIG_SYSRESET=y
CONFIG_SYSRESET_PSCI=y
CONFIG_TIMER=y
CONFIG_NXP3220_TIMER=y
CONFIG_USB=y
CONFIG_USB_EHCI_HCD=y
CONFIG_USB_EHCI_GENERIC=y
CONFIG_USB_STORAGE=y
CONFIG_USB_GADGET=y
CONFIG_USB_GADGET_MANUFACTURER="Nexell"
CONFIG_USB_GADGET_VENDOR_NUM=0x18d1
CONFIG_USB_GADGET_PRODUCT_NUM=0x0002
CONFIG_USB_GADGET_DWC2_OTG=y
CONFIG_USB_GADGET_DWC2_NEXELL_OTG=y
CONFIG_USB_GADGET_DWC2_NEXELL_DOWNLOADER=y
CONFIG_OF_LIBFDT_OVERLAY=y
# CONFIG_EFI_LOADER is not set
```

## drivers/clk/nexell/Kconfig
```kconfig
config CLK_NEXELL
	bool "Nexell Clock interface"
	depends on CLK
	help
	  This enables support for common clock driver API on Nexell SoCs.

menu "Clock drivers for Nexell SoCs"
	depends on CLK_NEXELL

config CLK_NXP3220
	bool "Clock driver for Nexell nxp3220 SoC"
	default y
	help
	  This enables common clock driver support for platforms based
	  on Nexell nxp3220.

endmenu
```

## drivers/pinctrl/nexell/Kconfig
```kconfig
config PINCTRL_NEXELL
	bool

config PINCTRL_NEXELL_NXP3220
	bool "Nexell nxp3220 SoC pinctrl driver"
	default y
	depends on ARCH_NEXELL && PINCTRL_FULL
	select PINCTRL_NEXELL
```

## drivers/video/nexell/Kconfig
```kconfig
if VIDEO_NEXELL

config VIDEO_NEXELL_LCD
	bool

menu "NexeLL LCD select"

config VIDEO_NEXELL_RGB
	bool "RGB"
	select VIDEO_NEXELL_LCD
	help
	  Support for RGB display panel.

config VIDEO_NEXELL_LVDS
	bool "LVDS"
	select VIDEO_NEXELL_LCD
	help
	  Support for LVDS display panel.

endmenu

endif
```
