/*
 * (C) Copyright 2018 Nexell
 * JungHyun, Kim <jhkim@nexell.co.kr>
 *
 * SPDX-License-Identifier:      GPL-2.0+
 */

/dts-v1/;

#include "nxp3220-evb-common.dtsi"

/ {
	model = "Nexell nxp3220 evb board";
	compatible = "nexell,nxp3220";
};

&ehci {
	status = "okay";
};
